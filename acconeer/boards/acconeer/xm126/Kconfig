## acconeer/boards/acconeer/xm126/Kconfig.xm126
```kconfig
# Copyright (c) 2023 Acconeer AB
# SPDX-License-Identifier: BSD-3-Clause

config BOARD_XM126
	select SOC_NRF52840_QIAA
```

## acconeer/boards/acconeer/xm126/xm126_defconfig
```kconfig
# SPDX-License-Identifier: BSD-3-Clause

# Enable MPU
CONFIG_ARM_MPU=y

# enable GPIO
CONFIG_GPIO=y

# enable SPI
CONFIG_SPI=y

# enable PINCTRL
CONFIG_PINCTRL=y

# enable uart driver
CONFIG_SERIAL=y

# enable console
CONFIG_CONSOLE=y
CONFIG_UART_CONSOLE=y

CONFIG_LOG=y
CONFIG_LOG_MODE_IMMEDIATE=y
```

## acconeer/boards/shields/acconeer_xb122/Kconfig.shield
```kconfig
# Copyright (c) Copyright (c) 2022 Acconeer AB
# SPDX-License-Identifier: BSD-3-Clause

config SHIELD_ACCONEER_XB122
	def_bool $(shields_list_contains,acconeer_xb122)
```

## acconeer/dts/bindings/acc,a121.yaml
```yaml
# Copyright (c) 2022 Acconeer AB
# SPDX-License-Identifier: BSD-3-Clause

description: Acconeer A121 pulse coherent radar

compatible: "acc,a121"

include: spi-device.yaml
```

## acconeer/dts/bindings/acc,a121_hal.yaml
```yaml
# Copyright (c) 2022 Acconeer AB
# SPDX-License-Identifier: BSD-3-Clause

description: Acconeer A121 pulse coherent radar

compatible: "acc,a121_hal"


properties:
    acc-sensor-interrupt-gpios:
      type: phandle-array
      required: true
      description: IRQ lines of A121 sensors.

    acc-sensor-enable-gpios:
      type: phandle-array
      required: true
      description: Enable lines of A121 sensors.

    acc-power-enable-gpios:
      type: phandle-array
      required: false
      description: Power switch or PMU enable

    acc-sensor-select-gpios:
      type: phandle-array
      required: false
      description: XE121 style sensor selection

    acc-sensor-stab-time-us:
      type: int
      required: true
      description: Sensor crystal stabilization time

    acc-ps-enable-time:
      type: int
      required: false
      description: Power switch enable stabilization time

    acc-spi-freq:
      type: int
      required: false
      description: Max SPI frequency supported by board

    acc-max-spi-transfer-size:
      type: int
      required: true
      description: Max length of a SPI transfer to sensor

    acc-interrupt-polling-delay-us:
      type: int
      required: false
      description: Define this if you would like to use polling to detect value change on the interrupt pin. Suggested value 10 (ms).
```
